## meta-exanest/conf/layer.conf
```bitbake
# We have a conf and classes directory, add to BBPATH
BBPATH .= ":${LAYERDIR}"

# We have recipes-* directories, add to BBFILES
BBFILES += "${LAYERDIR}/recipes-*/*/*.bb \
  ${LAYERDIR}/recipes-*/*/*.bbappend"

BBFILE_COLLECTIONS += "exanest"
BBFILE_PATTERN_exanest = "^${LAYERDIR}/"
BBFILE_PRIORITY_exanest = "15"

# for now we remove this
BBMASK += "meta-python3/recipes-utils/ast-mdio"
```

## meta-exanest/meta-track1/conf/layer.conf
```bitbake
# We have a conf and classes directory, add to BBPATH
BBPATH .= ":${LAYERDIR}"

# We have recipes-* directories, add to BBFILES
BBFILES += "${LAYERDIR}/recipes-*/*/*.bb \
  ${LAYERDIR}/recipes-*/*/*.bbappend"

BBFILE_COLLECTIONS += "track1"
BBFILE_PATTERN_track1 = "^${LAYERDIR}/"
BBFILE_PRIORITY_track1 = "25"
```

## meta-exanest/meta-track1/conf/local.conf
```bitbake
#
# Local configuration file for building the OpenBMC image.
#

# Machine Selection
MACHINE ??= "track1"

# OpenBMC distro settings
DISTRO ?= "openbmc-iceotope"

# The following will enable a build capable of verified-boot.
# Images and the resultant flash are always built as a FIT (firmware image).
# When verified-boot is enabled, the U-Boot firmware attempts to be built as
# a ROM part and upgradable part using the SPL options.
#
# A public key must be configured, which will be built into the resultant ROM.
# Most build logic is represented in the U-Boot recipes.
# IMAGE_FEATURES += " verified-boot "

TARGET_CFLAGS += " -fPIC"
#Stop the vboot overriding the copying file in the openbmc. for now anyhow.
BBMASK_append = " common/recipes-utils/vboot-utils/openbmc.*\.bbappend"

# Stop kernel being put in the image
RDEPENDS_kernel-base = ""

#Extra version
DISTRO_VERSION += " (TB1_Release)"
```

## meta-exanest/meta-track1/conf/local.conf.sample
```bitbake
#
# Local configuration file for building the OpenBMC image.
#

# Machine Selection
MACHINE ??= "track1"

# OpenBMC distro settings
DISTRO ?= "openbmc-iceotope"

# The following will enable a build capable of verified-boot.
# Images and the resultant flash are always built as a FIT (firmware image).
# When verified-boot is enabled, the U-Boot firmware attempts to be built as
# a ROM part and upgradable part using the SPL options.
#
# A public key must be configured, which will be built into the resultant ROM.
# Most build logic is represented in the U-Boot recipes.
# IMAGE_FEATURES += " verified-boot "

TARGET_CFLAGS += " -fPIC"
#Stop the vboot overriding the copying file in the openbmc. for now anyhow.
BBMASK_append = " common/recipes-utils/vboot-utils/openbmc.*\.bbappend"

# Stop kernel being put in the image
RDEPENDS_kernel-base = ""

# Uncomment this to disable the stripping of the sysroot
INHIBIT_SYSROOT_STRIP = "1"

# Uncomment this to disable the stripping of the installed binaries
INHIBIT_PACKAGE_STRIP = "1"

# The following options will build a companion 'debug filesystem' in addition
# to the normal deployable filesystem.  This companion system allows a
# debugger to know the symbols and related sources.  It can be used to
# debug a remote 'production' system without having to add the debug symbols
# and sources to remote system.  If IMAGE_FSTYPES_DEBUGFS is not defined, it
# defaults to IMAGE_FSTYPES.
IMAGE_GEN_DEBUGFS = "1"
IMAGE_FSTYPES_DEBUGFS = "tar.gz"
```

## meta-exanest/meta-track1/conf/machine/track1.conf
```bitbake
#@TYPE: Machine
#@NAME: track1
#@DESCRIPTION: Machine configuration for track1 microzed based BMC

require conf/machine/include/tune-zynq.inc
require conf/machine/include/machine-xilinx-default.inc
require conf/machine/include/machine-xilinx-board.inc

MACHINE_FEATURES = "ext2 vfat usbhost"

# u-boot configuration
PREFERRED_PROVIDER_virtual/bootloader = "u-boot-xlnx"

# This config will set up a custom ps7_init, which the
# platform-init package will copy over.
UBOOT_MACHINE = "zynq_iceotope_bmc_defconfig"
SPL_BINARY = "spl/boot.bin"

#EXTRA_IMAGEDEPENDS += " \
#                u-boot-zynq-uenv \
#                virtual/boot-bin \
#                "

SERIAL_CONSOLE = "115200 ttyPS0"

MACHINE_ESSENTIAL_EXTRA_RDEPENDS += "device-tree"

MACHINE_DEVICETREE = "track1/track1-zynq7.dts"

IMAGE_BOOT_FILES += "boot.bin ${MACHINE}.dtb"

#PREFERRED_VERSION_u-boot = "v2016.07"
#PREFERRED_VERSION_u-boot-mkimage = "v2016.07"
#PREFERRED_VERSION_u-boot-fw-utils = "v2016.07"
#PREFERRED_VERSION_linux-xilix = "4.1.15"
#PREFERRED_VERSION_fw-util = "0.1"

# zImage, as we are going to add it to the FIT image
KERNEL_IMAGETYPE = "zImage"
```

## meta-exanest/meta-track2/conf/bblayers.conf
```bitbake
# LAYER_CONF_VERSION is increased each time build/conf/bblayers.conf
# changes incompatibly
LCONF_VERSION = "6"

BBPATH = "${TOPDIR}"
BBFILES ?= ""

BBLAYERS ?= " \
  /home/marck/git/openbmc/yocto/krogoth/poky/meta \
  /home/marck/git/openbmc/yocto/krogoth/poky/meta-poky \
  /home/marck/git/openbmc/yocto/krogoth/poky/meta-yocto-bsp \
  /home/marck/git/openbmc/yocto/krogoth/poky/../meta-xilinx \
  /home/marck/git/openbmc/yocto/krogoth/poky/../meta-openembedded/meta-oe \
  /home/marck/git/openbmc/yocto/krogoth/poky/../meta-openembedded/meta-networking \
  /home/marck/git/openbmc/yocto/krogoth/poky/../meta-openembedded/meta-python \
  /home/marck/git/openbmc/yocto/krogoth/poky/../../.. \
  /home/marck/git/openbmc/yocto/krogoth/poky/../../../meta-openbmc/meta-exanest \
  /home/marck/git/openbmc/yocto/krogoth/poky/../../../meta-openbmc/meta-exanest/meta-track2 \
  /home/marck/git/openbmc/yocto/krogoth/poky/../../../meta-openbmc/meta-exanest/meta-python3 \
  "
BBLAYERS_NON_REMOVABLE ?= " \
  /home/marck/git/openbmc/yocto/krogoth/poky/meta \
  /home/marck/git/openbmc/yocto/krogoth/poky/meta-poky \
  "
```

## meta-exanest/meta-track2/conf/layer.conf
```bitbake
# We have a conf and classes directory, add to BBPATH
BBPATH .= ":${LAYERDIR}"

# We have recipes-* directories, add to BBFILES
BBFILES += "${LAYERDIR}/recipes-*/*/*.bb \
  ${LAYERDIR}/recipes-*/*/*.bbappend"

BBFILE_COLLECTIONS += "track2"
BBFILE_PATTERN_track2 = "^${LAYERDIR}/"
BBFILE_PRIORITY_track2 = "25"
```

## meta-exanest/meta-track2/conf/machine/track2.conf
```bitbake
#@TYPE: Machine
#@NAME: track2
#@DESCRIPTION: Machine configuration for track2 microzed based BMC

require conf/machine/include/tune-zynq.inc
require conf/machine/include/machine-xilinx-default.inc
require conf/machine/include/machine-xilinx-board.inc

MACHINE_FEATURES = "ext2 vfat usbhost"

# u-boot configuration
PREFERRED_PROVIDER_virtual/bootloader = "u-boot-xlnx"

# This config will set up a custom ps7_init, which the
# platform-init package will copy over.
UBOOT_MACHINE = "zynq_icetope_bmc_defconfig"
SPL_BINARY = "spl/boot.bin"

#EXTRA_IMAGEDEPENDS += " \
#                u-boot-zynq-uenv \
#                virtual/boot-bin \
#                "

SERIAL_CONSOLE = "115200 ttyPS0"

MACHINE_ESSENTIAL_EXTRA_RDEPENDS += "device-tree"

MACHINE_DEVICETREE = "track2/track2-zynq7.dts"

IMAGE_BOOT_FILES += "boot.bin ${MACHINE}.dtb"

#PREFERRED_VERSION_u-boot = "v2016.07"
#PREFERRED_VERSION_u-boot-mkimage = "v2016.07"
#PREFERRED_VERSION_u-boot-fw-utils = "v2016.07"
#PREFERRED_VERSION_linux-xilix = "4.1.15"
#PREFERRED_VERSION_fw-util = "0.1"

#KERNEL_IMAGETYPE = "zImage"

#require conf/machine/include/ast1250.inc
```
